## conf/bblayers.conf
```bitbake
# LAYER_CONF_VERSION is increased each time build/conf/bblayers.conf
# changes incompatibly
LCONF_VERSION = "6"

BBPATH = "${TOPDIR}"
BBFILES ?= ""

BBLAYERS ?= " \
  /opt2/test1/poky/meta \
  /opt2/test1/poky/meta-hob \
  /opt2/test1/poky/meta-yocto \
  /opt2/test1/poky/meta-yocto-bsp \
  /opt2/test1/poky/meta-sunxi "
  /opt2/test1/poky/meta-cubie-ds \
  "

BBLAYERS_NON_REMOVABLE ?= " \
  /opt2/test1/poky/meta \
  /opt2/test1/poky/meta-yocto \
  /opt2/test1/poky/meta-sunxi "
  /opt2/test1/poky/meta-cubie-ds \
  "


## TODO add ds stuff
```
